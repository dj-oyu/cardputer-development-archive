## archives/ayatsuri-dot8-private-idf-harness-control-v2-20261105/sdkconfig.defaults
```kconfig
CONFIG_IDF_TARGET="esp32s3"
CONFIG_COMPILER_OPTIMIZATION_SIZE=y
CONFIG_COMPILER_OPTIMIZATION_ASSERTIONS_ENABLE=y
CONFIG_ESPTOOLPY_FLASHSIZE_8MB=y
# CONFIG_FREERTOS_UNICORE is not set
# CONFIG_FREERTOS_FPU_IN_ISR is not set
CONFIG_ESP_SYSTEM_PANIC_PRINT_HALT=y
CONFIG_LOG_DEFAULT_LEVEL_ERROR=y
CONFIG_BOOTLOADER_LOG_LEVEL_ERROR=y
```

## archives/qemu-skin-q7-verification-20261111/tools/qemu_q7/sdkconfig.defaults
```kconfig
CONFIG_IDF_TARGET="esp32s3"
CONFIG_ESPTOOLPY_FLASHSIZE_8MB=y
CONFIG_PARTITION_TABLE_SINGLE_APP_LARGE=y
CONFIG_ESP_MAIN_TASK_STACK_SIZE=24576
CONFIG_ESP_TASK_WDT_EN=n
CONFIG_COMPILER_OPTIMIZATION_PERF=y
CONFIG_ESP_CONSOLE_UART_BAUDRATE=115200
CONFIG_SPIRAM=n
```
